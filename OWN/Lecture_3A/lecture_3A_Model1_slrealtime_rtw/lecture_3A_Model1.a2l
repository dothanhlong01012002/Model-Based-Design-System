/******************************************************************************
* ASAP2 file: lecture_3A_Model1.a2l
* Code generation for model "lecture_3A_Model1".
* Model version : 1.45
* Simulink Coder version : 10.3 R2021a
* C source code generated on : Tue Dec 19 15:02:03 2023
* Target selection: slrealtime.tlc
* Embedded hardware selection: Intel->x86-64 (Linux 64)
* Code generation objectives: Unspecified
* Validation result: Not run
* (add additional file header information here)
******************************************************************************/ ASAP2_VERSION 1 71
/begin PROJECT ProjectName "Project Comment Goes Here"
/begin HEADER "Header Comments go here" /end HEADER
/begin MODULE ModuleName "Module Comment Goes Here"
/begin IF_DATA XCP
 /begin PROTOCOL_LAYER 0x0100 0x03E8 0x00C8 0x0000 0x0000 0x0000 0x0000 0x0000 0xFC 0x0578 BYTE_ORDER_MSB_LAST ADDRESS_GRANULARITY_BYTE OPTIONAL_CMD ALLOC_ODT_ENTRY OPTIONAL_CMD ALLOC_ODT OPTIONAL_CMD ALLOC_DAQ OPTIONAL_CMD FREE_DAQ OPTIONAL_CMD GET_DAQ_RESOLUTION_INFO OPTIONAL_CMD GET_DAQ_PROCESSOR_INFO OPTIONAL_CMD START_STOP_SYNCH OPTIONAL_CMD START_STOP_DAQ_LIST OPTIONAL_CMD SET_DAQ_LIST_MODE OPTIONAL_CMD WRITE_DAQ OPTIONAL_CMD SET_DAQ_PTR OPTIONAL_CMD GET_CAL_PAGE OPTIONAL_CMD SET_CAL_PAGE OPTIONAL_CMD COPY_CAL_PAGE OPTIONAL_CMD SHORT_DOWNLOAD OPTIONAL_CMD DOWNLOAD_MAX OPTIONAL_CMD DOWNLOAD OPTIONAL_CMD SHORT_UPLOAD OPTIONAL_CMD UPLOAD OPTIONAL_CMD SET_MTA /end PROTOCOL_LAYER
 /begin DAQ DYNAMIC 0x0000 0x0080 0x00 OPTIMISATION_TYPE_DEFAULT ADDRESS_EXTENSION_FREE IDENTIFICATION_FIELD_TYPE_RELATIVE_WORD_ALIGNED GRANULARITY_ODT_ENTRY_SIZE_DAQ_BYTE 0xFF OVERLOAD_INDICATION_PID PRESCALER_SUPPORTED /begin STIM GRANULARITY_ODT_ENTRY_SIZE_STIM_BYTE 0xFF /end STIM /begin TIMESTAMP_SUPPORTED 0x0001 SIZE_DWORD UNIT_1US TIMESTAMP_FIXED /end TIMESTAMP_SUPPORTED /begin EVENT "100 us" "100 us" 0x0000 DAQ 0xFF 0x01 0x05 0x00 /end EVENT /end DAQ
 /begin XCP_ON_UDP_IP 0x0100 0x15B3 ADDRESS "192.168.1.5" /end XCP_ON_UDP_IP
/end IF_DATA
/begin MOD_PAR "MOD PAR Comment Goes Here" /end MOD_PAR
/begin MOD_COMMON "Mod Common Comment Here" BYTE_ORDER MSB_LAST ALIGNMENT_BYTE 1 ALIGNMENT_WORD 2 ALIGNMENT_LONG 8 ALIGNMENT_FLOAT32_IEEE 4 ALIGNMENT_FLOAT64_IEEE 8 ALIGNMENT_INT64 4 /end MOD_COMMON
/begin MEASUREMENT lecture_3A_Model1_B.Actual_RPM "" FLOAT64_IEEE lecture_3A_Model1_CM_double 0 0 -1.7E+308 1.7E+308 ECU_ADDRESS 0x00215668 /end MEASUREMENT
/begin MEASUREMENT lecture_3A_Model1_B.ControllerTorqueRequest "" FLOAT64_IEEE lecture_3A_Model1_CM_double 0 0 -1.7E+308 1.7E+308 ECU_ADDRESS 0x00215680 /end MEASUREMENT
/begin MEASUREMENT lecture_3A_Model1_B.Desired_RPM "" FLOAT64_IEEE lecture_3A_Model1_CM_double 0 0 -1.7E+308 1.7E+308 ECU_ADDRESS 0x002156D0 /end MEASUREMENT
/begin MEASUREMENT lecture_3A_Model1_B.Gain "" FLOAT64_IEEE lecture_3A_Model1_CM_double 0 0 -1.7E+308 1.7E+308 ECU_ADDRESS 0x00215678 /end MEASUREMENT
/begin MEASUREMENT lecture_3A_Model1_B.Gain2 "" FLOAT64_IEEE lecture_3A_Model1_CM_double_1 0 0 -1.7E+308 1.7E+308 ECU_ADDRESS 0x00215640 /end MEASUREMENT
/begin MEASUREMENT lecture_3A_Model1_B.GeneratorCurrent "" FLOAT64_IEEE lecture_3A_Model1_CM_double 0 0 -1.7E+308 1.7E+308 ECU_ADDRESS 0x00215628 /end MEASUREMENT
/begin MEASUREMENT lecture_3A_Model1_B.GeneratorVoltage "" FLOAT64_IEEE lecture_3A_Model1_CM_double 0 0 -1.7E+308 1.7E+308 ECU_ADDRESS 0x00215620 /end MEASUREMENT
/begin MEASUREMENT lecture_3A_Model1_B.Generator_Torque "" FLOAT64_IEEE lecture_3A_Model1_CM_double 0 0 -1.7E+308 1.7E+308 ECU_ADDRESS 0x00215618 /end MEASUREMENT
/begin MEASUREMENT lecture_3A_Model1_B.INPUT_1_1_1 "" FLOAT64_IEEE lecture_3A_Model1_CM_double 0 0 -1.7E+308 1.7E+308 LAYOUT COLUMN_DIR MATRIX_DIM 4 ECU_ADDRESS 0x00215648 /end MEASUREMENT
/begin MEASUREMENT lecture_3A_Model1_B.INPUT_2_1_1 "" FLOAT64_IEEE lecture_3A_Model1_CM_double 0 0 -1.7E+308 1.7E+308 LAYOUT COLUMN_DIR MATRIX_DIM 4 ECU_ADDRESS 0x002156A8 /end MEASUREMENT
/begin MEASUREMENT lecture_3A_Model1_B.LTI_OUTPUT_1_1 "" FLOAT64_IEEE lecture_3A_Model1_CM_double 0 0 -1.7E+308 1.7E+308 LAYOUT COLUMN_DIR MATRIX_DIM 3 ECU_ADDRESS 0x00215600 /end MEASUREMENT
/begin MEASUREMENT lecture_3A_Model1_B.LTI_STATE_1 "" FLOAT64_IEEE lecture_3A_Model1_CM_double 0 0 -1.7E+308 1.7E+308 LAYOUT COLUMN_DIR MATRIX_DIM 4 ECU_ADDRESS 0x002155E0 /end MEASUREMENT
/begin MEASUREMENT lecture_3A_Model1_B.Motor_Torque "" FLOAT64_IEEE lecture_3A_Model1_CM_double 0 0 -1.7E+308 1.7E+308 ECU_ADDRESS 0x00215688 /end MEASUREMENT
/begin MEASUREMENT lecture_3A_Model1_B.OZinAmp "" FLOAT64_IEEE lecture_3A_Model1_CM_double 0 0 -1.7E+308 1.7E+308 ECU_ADDRESS 0x00215630 /end MEASUREMENT
/begin MEASUREMENT lecture_3A_Model1_B.OZintoNm "" FLOAT64_IEEE lecture_3A_Model1_CM_double 0 0 -1.7E+308 1.7E+308 ECU_ADDRESS 0x00215638 /end MEASUREMENT
/begin MEASUREMENT lecture_3A_Model1_B.Saturation "" FLOAT64_IEEE lecture_3A_Model1_CM_double_1 0 0 -1.7E+308 1.7E+308 ECU_ADDRESS 0x002156A0 /end MEASUREMENT
/begin MEASUREMENT lecture_3A_Model1_B.Sum "" FLOAT64_IEEE lecture_3A_Model1_CM_double 0 0 -1.7E+308 1.7E+308 ECU_ADDRESS 0x00215670 /end MEASUREMENT
/begin MEASUREMENT lecture_3A_Model1_B.Torque_NM "" FLOAT64_IEEE lecture_3A_Model1_CM_double 0 0 -1.7E+308 1.7E+308 ECU_ADDRESS 0x002156C8 /end MEASUREMENT
/begin MEASUREMENT lecture_3A_Model1_B.Torque_Nm "" FLOAT64_IEEE lecture_3A_Model1_CM_double 0 0 -1.7E+308 1.7E+308 ECU_ADDRESS 0x00215698 /end MEASUREMENT
/begin MEASUREMENT lecture_3A_Model1_B.uDLookupTable "" FLOAT64_IEEE lecture_3A_Model1_CM_double 0 0 -1.7E+308 1.7E+308 ECU_ADDRESS 0x00215690 /end MEASUREMENT
/begin MEASUREMENT lecture_3A_Model1_DW.INPUT_1_1_1_Discrete "" FLOAT64_IEEE lecture_3A_Model1_CM_double 0 0 -1.7E+308 1.7E+308 LAYOUT COLUMN_DIR MATRIX_DIM 2 ECU_ADDRESS 0x00215588 /end MEASUREMENT
/begin MEASUREMENT lecture_3A_Model1_DW.INPUT_2_1_1_Discrete "" FLOAT64_IEEE lecture_3A_Model1_CM_double 0 0 -1.7E+308 1.7E+308 LAYOUT COLUMN_DIR MATRIX_DIM 2 ECU_ADDRESS 0x00215598 /end MEASUREMENT
/begin MEASUREMENT lecture_3A_Model1_DW.LTI_STATE_1_FirstOutput "" FLOAT64_IEEE lecture_3A_Model1_CM_double 0 0 -1.7E+308 1.7E+308 ECU_ADDRESS 0x00215580 /end MEASUREMENT
/begin COMPU_METHOD lecture_3A_Model1_CM_double "" IDENTICAL "%15.10" "" /end COMPU_METHOD
/begin COMPU_METHOD lecture_3A_Model1_CM_double_1 "" IDENTICAL "%15.10" "1" /end COMPU_METHOD
/begin RECORD_LAYOUT Scalar_FLOAT64_IEEE FNC_VALUES 1 FLOAT64_IEEE COLUMN_DIR DIRECT /end RECORD_LAYOUT
/begin GROUP lecture_3A_Model1 "lecture_3A_Model1" ROOT /end GROUP
/end MODULE
/end PROJECT
